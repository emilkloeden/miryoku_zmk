/ {
    chosen {
        zmk,display = &oled;
    };

    oled: ssd1306@3c {
        compatible = "solomon,ssd1306fb";
        reg = <0x3c>;
        label = "DISPLAY";
        width = <128>;
        height = <32>;
        segment-offset = <0>;
        page-offset = <0>;
        reset-gpios = <>;
        rotation = <0>;
        controller-type = "ssd1306";
        i2c-bus = <&i2c0>;
    };
};
